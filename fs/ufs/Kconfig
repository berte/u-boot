## fs/ufs/Kconfig
```kconfig
config FS_UFS
    bool "Enable UFS/FFSv1/FFSv2 filesystem support"
    help
    This provides support for reading images from the ufs and variant filesystem.
    ufs is a widely used general-purpose filesystem for NetBSD.
    You can also enable CMD_UFS to get access to UFS commands.

config FS_UFS_WRITE
    depends on FS_UFS
    bool "Enable UFS/FFSv1/FFSv2 filesystem write support(NOT IMPLEMENTED, DO NOT USE)"
    help
    This provides support for writing data to the ufs and variant filesystem.
    NOT IMLEMENTED, PLEASE DO NOT USE THIS.
```
